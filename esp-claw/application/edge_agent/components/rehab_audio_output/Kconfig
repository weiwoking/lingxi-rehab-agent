## esp-claw/application/edge_agent/components/rehab_audio_output/Kconfig
```kconfig
menu "Rehabilitation audio output"

    config REHAB_AUDIO_TTS_BASE_URL
        string "PC TTS service base URL"
        default "http://192.168.137.1:8765"
        help
            Centralized HTTP origin for the PC-side P4 Rehab TTS service.

    config REHAB_AUDIO_TTS_TIMEOUT_MS
        int "TTS request timeout (ms)"
        range 1000 30000
        default 10000

    config REHAB_AUDIO_OUTPUT_VOLUME
        int "TTS output volume"
        range 0 100
        default 100
        help
            Frozen Phase 1 value is 100. It may be lowered temporarily for the
            user's first hardware safety check without changing board gain.

    config REHAB_AUDIO_OUTPUT_CODEC_BOOST_DB_X10
        int "Experimental codec output boost (0.1 dB)"
        range 0 20
        default 20
        help
            Raises the esp_codec_dev output volume-curve endpoint without
            changing the 0-100 business volume protocol or board PA metadata.
            The V1 hardware experiment default is 20 (+2.0 dB). Set to 0 to
            restore the stock 0.0 dB endpoint.

endmenu
```

## esp-claw/application/edge_agent/components/rehab_person_follow/Kconfig
```kconfig
menu "Rehab person follow (real perception, no vehicle action)"

config REHAB_PERSON_FOLLOW_ENABLED
    bool "Enable the independent person-follow component"
    default y

config REHAB_PERSON_FOLLOW_ACTION_ENABLED
    bool "Enable person-follow vehicle actions"
    depends on REHAB_PERSON_FOLLOW_ENABLED
    default n
    help
        This phase does not support vehicle actions. The component rejects a true
        runtime action_enabled value even if this development option is set.

config REHAB_PERSON_FOLLOW_MOCK_MODE
    int "Default mock perception mode"
    depends on REHAB_PERSON_FOLLOW_ENABLED
    range 0 5
    default 0
    help
        0=no target, 1=left, 2=center, 3=right,
        4=alternating left/right, 5=technical error.

config REHAB_PERSON_FOLLOW_PERCEPTION_REAL
    bool "Use real Camera JPEG and PC person-follow perception"
    depends on REHAB_PERSON_FOLLOW_ENABLED
    default y

config REHAB_PERSON_FOLLOW_PC_ENDPOINT
    string "Fallback PC person-follow endpoint"
    depends on REHAB_PERSON_FOLLOW_ENABLED
    default "http://192.168.137.1:8000/api/v1/person-follow/detect"
    help
        Used only when the application cannot derive the endpoint from its
        existing perception_fusion_url host and port.

config REHAB_PERSON_FOLLOW_HTTP_TIMEOUT_MS
    int "Person-follow HTTP total timeout (ms)"
    depends on REHAB_PERSON_FOLLOW_ENABLED
    range 500 10000
    default 2000

config REHAB_PERSON_FOLLOW_CAMERA_TIMEOUT_MS
    int "Camera JPEG acquire timeout (ms)"
    depends on REHAB_PERSON_FOLLOW_ENABLED
    range 100 10000
    default 1000

config REHAB_PERSON_FOLLOW_LOOP_INTERVAL_MS
    int "Real perception loop interval (ms)"
    depends on REHAB_PERSON_FOLLOW_ENABLED
    range 10 60000
    default 200

config REHAB_PERSON_FOLLOW_MAX_DETECTIONS
    int "Maximum accepted person detections"
    depends on REHAB_PERSON_FOLLOW_ENABLED
    range 1 16
    default 16

config REHAB_PERSON_FOLLOW_MAX_RUNTIME_MS
    int "Maximum worker runtime (ms)"
    depends on REHAB_PERSON_FOLLOW_ENABLED
    range 100 3600000
    default 600000

config REHAB_PERSON_FOLLOW_MAX_CONSECUTIVE_ERRORS
    int "Maximum consecutive perception errors"
    depends on REHAB_PERSON_FOLLOW_ENABLED
    range 1 32
    default 3

endmenu
```

## esp-claw/application/edge_agent/components/rehab_score_bridge/Kconfig
```kconfig
menu "Rehabilitation score bridge"

config REHAB_SCORE_BRIDGE_ENABLED
    bool "Enable the P4-to-PC rehabilitation score bridge"
    default y
    help
        Upload finalized rehabilitation sessions to the configured trusted-LAN
        PC score service and persist compact status/results on the SD card.

endmenu
```

## esp-claw/application/edge_agent/components/rehab_task_decision/Kconfig
```kconfig
choice REHAB_DECISION_THINKING_MODE
    prompt "Formal rehab decision DeepSeek thinking mode"
    default REHAB_DECISION_THINKING_ENABLED_HIGH
    help
        Applies only to the Local UI / Root formal rehab decision request.
        It does not change memory extraction or other agent requests.

    config REHAB_DECISION_THINKING_ENABLED_HIGH
        bool "Thinking enabled, explicit high effort"
        help
            Explicitly enables thinking and pins DeepSeek reasoning effort to
            high. This is the conservative default and avoids an automatic
            promotion to max where the provider would otherwise apply one.

    config REHAB_DECISION_THINKING_DISABLED
        bool "Thinking disabled"
        help
            Explicitly selects DeepSeek non-thinking mode for formal rehab
            decision A/B testing. Validate quality and tool-call reliability
            before retaining this selection.
endchoice
```

## esp-claw/application/edge_agent/sdkconfig.defaults.esp32p4
```kconfig
CONFIG_BT_ENABLED=n
CONFIG_APP_CLAW_LUA_MODULE_BLE_HID=n
CONFIG_ESP_WIFI_REMOTE_ENABLED=y
CONFIG_ESP_WIFI_REMOTE_LIBRARY_HOSTED=y
CONFIG_SLAVE_IDF_TARGET_ESP32C6=y
CONFIG_ESP_HOSTED_CP_TARGET_ESP32C6=y
CONFIG_ESP_HOSTED_P4_DEV_BOARD_NONE=y
CONFIG_ESP_HOSTED_SDIO_HOST_INTERFACE=y
CONFIG_ESP_HOSTED_SDIO_SLOT_1=y
CONFIG_ESP_HOSTED_SDIO_4_BIT_BUS=y
CONFIG_ESP_HOSTED_PRIV_SDIO_PIN_CMD_SLOT_1=19
CONFIG_ESP_HOSTED_PRIV_SDIO_PIN_CLK_SLOT_1=18
CONFIG_ESP_HOSTED_PRIV_SDIO_PIN_D0_SLOT_1=14
CONFIG_ESP_HOSTED_PRIV_SDIO_PIN_D1_4BIT_BUS_SLOT_1=15
CONFIG_ESP_HOSTED_PRIV_SDIO_PIN_D2_4BIT_BUS_SLOT_1=16
CONFIG_ESP_HOSTED_PRIV_SDIO_PIN_D3_4BIT_BUS_SLOT_1=17
CONFIG_ESP_HOSTED_SDIO_GPIO_RESET_SLAVE=54
CONFIG_LWIP_TCP_SND_BUF_DEFAULT=32768
CONFIG_WIFI_RMT_STATIC_TX_BUFFER=y
CONFIG_WIFI_RMT_STATIC_TX_BUFFER_NUM=16
# CONFIG_WIFI_RMT_DYNAMIC_TX_BUFFER is not set
CONFIG_WIFI_RMT_AMPDU_TX_ENABLED=y
CONFIG_WIFI_RMT_TX_BA_WIN=6
# CONFIG_ESP_CONSOLE_UART_DEFAULT is not set
CONFIG_ESP_CONSOLE_USB_SERIAL_JTAG=y

CONFIG_ESP_CONSOLE_SECONDARY_NONE=y
# CONFIG_ESP_CONSOLE_SECONDARY_USB_SERIAL_JTAG is not set
```
